## conf/distro/audiobox-distro.conf
```bitbake
DISTRO = "audiobox-distro"
DISTRO_NAME = "MP1 Audio Box (A Yocto Project Based Distro)"
DISTRO_VERSION = "0.1"

MAINTAINER = "Matteo D'Aria <teodaria@gmail.com>"

# Add image name for generated SDK and set default SDK install folder
SDK_NAME = "${IMAGE_LINK_NAME}-${SDK_ARCH}"
SDKPATH = "/opt/st/${MACHINE}/${SDK_VERSION}"
# Don't include the DATE variable in the sstate package signatures
SDKPATH[vardepsexclude] = "DATE"

LOCALCONF_VERSION = "1"
LAYER_CONF_VERSION ?= "1"

IMAGE_LINGUAS = "en-us en-gb"

# =========================================================================
# DISTRO features
# =========================================================================
DISTRO_FEATURES  = "alsa"

# add support of gstreamer
DISTRO_FEATURES_append = " gstreamer "

# add support of optee
DISTRO_FEATURES_append = " optee "

# add support of splashscreen
DISTRO_FEATURES_append = " splashscreen "

# add support of wayland
DISTRO_FEATURES_append = " wayland pam "

# add support of X11
DISTRO_FEATURES_append = " x11 "

# add support of KDE (since OE thud version)
DISTRO_FEATURES_append = " kde "

# add support of systemd
DISTRO_FEATURES_append = " systemd polkit "


# Disabling sysvinit
DISTRO_FEATURES_BACKFILL_CONSIDERED += "sysvinit"

VIRTUAL-RUNTIME_init_manager = "systemd"
VIRTUAL-RUNTIME_initscripts = "systemd-compat-units"

DISTRO_FEATURES_append = " opengl"
DISTRO_FEATURES_append = " gplv3 "

# =========================================================================
# Preferred version
# =========================================================================

# =========================================================================
# IMAGE addons
# =========================================================================
```

## conf/layer.conf
```bitbake
# We have a conf and classes directory, add to BBPATH
BBPATH .= ":${LAYERDIR}"

# We have recipes-* directories, add to BBFILES
BBFILES += "${LAYERDIR}/recipes-*/*/*.bb \
            ${LAYERDIR}/recipes-*/*/*.bbappend"

BBFILE_COLLECTIONS += "meta-audiobox-distro"
BBFILE_PATTERN_meta-audiobox-distro = "^${LAYERDIR}/"
BBFILE_PRIORITY_meta-audiobox-distro = "10"

LAYERDEPENDS_meta-audiobox-distro = "core"
LAYERSERIES_COMPAT_meta-audiobox-distro = "dunfell"
```
